## Kconfig
```kconfig
config ZMK_BEHAVIOR_LAYER_TAP_REPEAT
    bool
    default y
    depends on DT_HAS_ZMK_BEHAVIOR_LAYER_TAP_REPEAT_ENABLED

config ZMK_BEHAVIOR_HOLD_TAP_FOLLOW
    bool
    default y
    depends on DT_HAS_ZMK_BEHAVIOR_HOLD_TAP_FOLLOW_ENABLED

if ZMK_BEHAVIOR_HOLD_TAP_FOLLOW

config ZMK_BEHAVIOR_HOLD_TAP_FOLLOW_MAX_HELD
    int "Hold-tap-follow max held"
    default 10

config ZMK_BEHAVIOR_HOLD_TAP_FOLLOW_MAX_CAPTURED_EVENTS
    int "Hold-tap-follow max captured events"
    default 40

endif
```

## dts/bindings/behaviors/zmk,behavior-hold-tap-follow.yaml
```yaml
# Copyright (c) 2020 The ZMK Contributors
# SPDX-License-Identifier: MIT

description: Hold-tap with hold-follow-key-positions (see src/behaviors/behavior_hold_tap_follow.c)

compatible: "zmk,behavior-hold-tap-follow"

include: two_param.yaml

properties:
  bindings:
    type: phandles
    required: true
  tapping-term-ms:
    type: int
  tapping_term_ms:
    type: int
    deprecated: true
  quick-tap-ms:
    type: int
    default: -1
  quick_tap_ms:
    type: int
    deprecated: true
  global-quick-tap:
    type: boolean
    deprecated: true
  require-prior-idle-ms:
    type: int
    default: -1
  flavor:
    type: string
    required: false
    default: "hold-preferred"
    enum:
      - "hold-preferred"
      - "balanced"
      - "tap-preferred"
      - "tap-unless-interrupted"
  hold-while-undecided:
    type: boolean
  hold-while-undecided-linger:
    type: boolean
  retro-tap:
    type: boolean
  hold-trigger-key-positions:
    type: array
    required: false
    default: []
  hold-trigger-on-release:
    type: boolean
  hold-follow-key-positions:
    type: array
    required: false
    default: []
    description: >
      If the first other key pressed while this key is undecided is at one of these positions,
      decide hold straight away, whichever key is released first.
```

## dts/bindings/behaviors/zmk,behavior-layer-tap-repeat.yaml
```yaml
description: Layer-tap that repeats its key when held alone (see src/behaviors/behavior_layer_tap_repeat.c)

compatible: "zmk,behavior-layer-tap-repeat"

include: two_param.yaml

properties:
  tapping-term-ms:
    type: int
    default: 180
  repeat-term-ms:
    type: int
    default: 400
  repeat-interval-ms:
    type: int
    default: 25
  quick-tap-ms:
    type: int
    default: 180
```
