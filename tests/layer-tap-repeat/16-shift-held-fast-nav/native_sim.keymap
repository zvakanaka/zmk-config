#include <dt-bindings/zmk/keys.h>
#include <behaviors.dtsi>
#include <dt-bindings/zmk/kscan_mock.h>
#include "../behavior_keymap.dtsi"

// Shift held: a fast Nav+J (all within the tapping term) gives Shift+Down
&kscan {
    events = <ZMK_MOCK_PRESS(1,2,50) ZMK_MOCK_PRESS(0,0,30) ZMK_MOCK_PRESS(0,1,30) ZMK_MOCK_RELEASE(0,1,30) ZMK_MOCK_RELEASE(0,0,50) ZMK_MOCK_RELEASE(1,2,500)>;
};
