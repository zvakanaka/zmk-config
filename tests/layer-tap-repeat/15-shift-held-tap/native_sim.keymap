#include <dt-bindings/zmk/keys.h>
#include <behaviors.dtsi>
#include <dt-bindings/zmk/kscan_mock.h>
#include "../behavior_keymap.dtsi"

// Shift held: a quick Bksp tap sends nothing
&kscan {
    events = <ZMK_MOCK_PRESS(1,2,50) ZMK_MOCK_PRESS(0,0,50) ZMK_MOCK_RELEASE(0,0,50) ZMK_MOCK_RELEASE(1,2,500)>;
};
