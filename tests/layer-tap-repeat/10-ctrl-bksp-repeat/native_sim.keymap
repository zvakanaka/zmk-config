#include <dt-bindings/zmk/keys.h>
#include <behaviors.dtsi>
#include <dt-bindings/zmk/kscan_mock.h>
#include "../behavior_keymap.dtsi"

&kscan {
    events = <ZMK_MOCK_PRESS(0,3,250) ZMK_MOCK_PRESS(0,0,660) ZMK_MOCK_RELEASE(0,0,50) ZMK_MOCK_RELEASE(0,3,500)>;
};
