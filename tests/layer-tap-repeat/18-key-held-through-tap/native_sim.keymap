#include <dt-bindings/zmk/keys.h>
#include <behaviors.dtsi>
#include <dt-bindings/zmk/kscan_mock.h>
#include "../behavior_keymap.dtsi"

// J held through the whole Bksp tap: no Backspace
&kscan {
    events = <ZMK_MOCK_PRESS(0,1,50) ZMK_MOCK_PRESS(0,0,50) ZMK_MOCK_RELEASE(0,0,50) ZMK_MOCK_RELEASE(0,1,500)>;
};
